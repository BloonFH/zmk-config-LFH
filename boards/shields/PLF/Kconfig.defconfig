## boards/shields/PLF/Kconfig.defconfig
```kconfig
# Copyright (c) 2020 The ZMK Contributors
# SPDX-License-Identifier: MIT

if SHIELD_PLF

config ZMK_KEYBOARD_NAME
    default "plf"

endif
```

## boards/shields/PLF/Kconfig.shield
```kconfig
# Copyright (c) 2020 The ZMK Contributors
# SPDX-License-Identifier: MIT

config SHIELD_PLF
    def_bool $(shields_list_contains,plf)
```
